#define HM_TAPPING_TERM 200
#define HM_TAPPING_TERM_FAST 150
#define HM_DEBOUNCE_DELAY 5
#define HM_PRIOR_IDLE 100

/ {
    behaviors {
        hm: homerow_mods {
            compatible = "zmk,behavior-hold-tap";
            label = "HOMEROW_MODS";
            #binding-cells = <2>;
            tapping-term-ms = <HM_TAPPING_TERM>;
            quick-tap-ms = <HM_TAPPING_TERM_FAST>;
            require-prior-idle-ms = <HM_PRIOR_IDLE>;
            flavor = "tap-preferred";
            bindings = <&kp>, <&kp>;
        };

        hmc: homerow_command {
            compatible = "zmk,behavior-hold-tap";
            label = "HOMEROW_COMMAND";
            #binding-cells = <2>;
            tapping-term-ms = <HM_TAPPING_TERM>;
            quick-tap-ms = <HM_TAPPING_TERM_FAST>;
            require-prior-idle-ms = <HM_PRIOR_IDLE>;
            flavor = "hold-preferred";
            bindings = <&kp>, <&kp>;
        };
    };
};
