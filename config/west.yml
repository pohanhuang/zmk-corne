## config/west.yml
```yaml
manifest:
  remotes:
    - name: zmkfirmware
      url-base: https://github.com/zmkfirmware
    - name: Linkeway                         
      url-base: https://github.com/Linkeway
  projects:
    - name: zmk
      remote: zmkfirmware
      revision: v0.3.0
      import: app/west.yml
    - name: niceview-dev-art                
      remote: Linkeway                  
      revision: main                    
  self:
    path: config
```
